## arch/arm64/hotplug/Kconfig
```kconfig
config THUNDERPLUG_CONTROL
	bool "Enable plugging down/up of cores based on load per core"
	default y
	help
	  This driver hotplugs cpu cores based on per-core load
```
